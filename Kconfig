## Kconfig
```kconfig
mainmenu "Rafael SDK Configuration"
osource "${APPLICATION_SOURCE_DIR}/VERSION"
menu "-------- SDK   Configuration --------"
endmenu
source "config/devices.config"

if (RT581 || RT582 || RT583 || RT584H ||  RT584S || RT584L)
choice APPLICATION_EXAMPLES_TYPE
	prompt "Select Application"
	default BASIC_EXAMPLE

config HELLOWORLD
	bool "hellow-world"
	select BUILD_COMPONENT_LOG
    select BUILD_COMPONENT_RT569
    select BUILD_COMPONENT_RUCI
    select BUILD_COMPONENT_UART_STDIO
    select BUILD_COMPONENT_UTILITY

config BASIC_EXAMPLE
	bool "Basic peripheral"

config BLUETOOTH_LE_EXAMPLE
	bool "Bluetooth"

config SUBG_EXAMPLE
	bool "Sub-G"

config ZIGBEE_EXAMPLE
	bool "Zigbee"


if BASIC_EXAMPLE
source "config/examples/basic_examples.config"
endif

if BLUETOOTH_LE_EXAMPLE
source "config/examples/ble_example.config"
source "config/components/network/bluetooth/ble.config"
endif

if SUBG_EXAMPLE 
source "config/examples/sub-g_examples.config"
source "config/components/network/subg_ctrl/subg_ctrl.config"
endif

if ZIGBEE_EXAMPLE 
source "config/examples/zigbee_examples.config"
source "config/components/network/zigbee/zigbee.config"
endif

if HELLOWORLD 
source "examples/helloworld/Kconfig"
endif
endchoice
endif


source "config/platform.config"
source "config/components/cpc/cpc.config"
source "config/components/network/rf/rf.config"
source "config/components/network/rt569-rf/rt569-rf.config"

source "config/components/platform/crypto/crypto.config"
source "config/components/utility/utility.config"
source "config/build_project.config"
source "config/compilier.config"
```

## components/Kconfig
```kconfig
menu "COMPONENT SETTING"

source "components/cpc/Kconfig"
source "components/network/Kconfig"
source "components/platform/Kconfig"
source "components/utility/Kconfig"

endmenu
```

## components/network/Kconfig
```kconfig
menu "NETWORK"

source "components/network/bluetooth/Kconfig"
source "components/network/css/Kconfig"
source "components/network/lmac15p4/Kconfig"
source "components/network/rt569-rf/Kconfig"
source "components/network/rt569-fw/Kconfig"
source "components/network/ruci/Kconfig"
source "components/network/subg_ctrl/Kconfig"
source "components/network/thread/Kconfig"
source "components/network/zigbee/Kconfig"

endmenu
```

## components/network/bluetooth/Kconfig
```kconfig
if BUILD_COMPONENT_BLUETOOTH_LE_HOST
menu "BLE MAX LINK NUM"
config BLE_SUPPORT_NUM_CONN_MAX
    int "Bluetooth LE MAX LINK NUM"
	def_int 1
    range 0 8
endmenu
endif # BUILD_COMPONENT_BLUETOOTH_LE_HOST
```

## components/network/thread/Kconfig
```kconfig
menu "THREAD"

config RADIO_2P4GHZ_OQPSK_SUPPORT
    depends on BUILD_COMPONENT_OPENTHREAD
    bool "2.4G"
	def_bool false
    help
        2.4G

config RADIO_SUBGHZ_OQPSK_SUPPORT
    depends on BUILD_COMPONENT_OPENTHREAD_SUBG
    bool "Sub-G"
	def_bool false
    help
        Sub-G
choice RADIO_BAND_SELECTION
prompt "RADIO BAND SELECTION"
default SUBG_FREQUENCY_BAND_915
config SUBG_FREQUENCY_BAND_915
    bool "915MHz"
config SUBG_FREQUENCY_BAND_868
    bool "868MHz"
config SUBG_FREQUENCY_BAND_470
    bool "470MHz"
config SUBG_FREQUENCY_BAND_433
    bool "433MHz"
    
endchoice


config OPENTHREAD_TASK_SIZE
    int "OPENTHREAD TASK SIZE"
    default 4096
    help
        OPENTHREAD TASK SIZE

choice OT_DEVICE_TYPE
prompt "OT DEVICE TYPE"
default OT_DEVICE_TYPE_RCP

config OT_DEVICE_TYPE_FTD
    bool "Full thread device"

config OT_DEVICE_TYPE_MTD
    bool "Minimal thread device"

config OT_DEVICE_TYPE_RCP
    bool "Thread radio co-processor"    

endchoice

choice OT_RCP_INTERFACE
depends on OT_DEVICE_TYPE_RCP
prompt "OT RCP INTERFACE"
default OT_RCP_HDLC

config OT_RCP_HDLC
    bool "HDLC"


config OT_RCP_EZMESH
    bool "EZMESH"

endchoice
endmenu
```

## components/platform/Kconfig
```kconfig
menu "PLATFROM"

source "components/platform/hosal/Kconfig"
source "components/platform/soc/Kconfig"

endmenu
```

## components/platform/soc/rt582/rt582_bootloader/Kconfig
```kconfig
menu "RT582 BOOTLOADER Configuration"

config BOOTLOADER_DEBUG
    bool "Enable bootloader debug"
    default n
    select BUILD_COMPONENT_UART_STDIO
    help
        Enable bootloader debug

endmenu
```

## examples/hci_raw/Kconfig
```kconfig
menu "PROJECT CONFIG"

config TEST_B_BOOL
    bool "Test BOOL"
	def_bool false
    help
        Test BOOL description

endmenu
```

## examples/peripheral/crypto/Kconfig
```kconfig
menu "PROJECT CONFIG"

config  CRYPTO_AES_ENABLE
    bool "CRYPTO_AES_ENABLE"
    default true

config CRYPTO_SECP192R1_ENABLE
    bool "CRYPTO_SECP192R1_ENABLE"
    default true

config CRYPTO_SECP256R1_ENABLE
    bool "CRYPTO_SECP256R1_ENABLE"
    default true

config CRYPTO_SECT163R2_ENABLE
    bool "CRYPTO_SECT163R2_ENABLE"
    default true

config CRYPTO_C25519_ENABLE
    bool "CRYPTO_C25519_ENABLE"
    default true

endmenu
```

## examples/peripheral/crypto/crypto_aes128_encrypt/Kconfig
```kconfig
menu "PROJECT CONFIG"

config  CRYPTO_AES_ENABLE
    bool "CRYPTO_AES_ENABLE"
    default 1


config CRYPTO_C25519_ENABLE
    bool "CRYPTO_C25519_ENABLE"
    default 1

config CRYPTO_SECP256R1_ENABLE
    bool "CRYPTO_SECP256R1_ENABLE"
    default 1

config CRYPTO_SECP192R1_ENABLE
    bool "CRYPTO_SECP192R1_ENABLE"
    default 1

config CRYPTO_SECT163R2_ENABLE
    bool "CRYPTO_SECT163R2_ENABLE"
    default 1

if RT584
config CRYPTO_SM3_ENABLE
    bool "CRYPTO_SM3_ENABLE"
    default 1

config  CRYPTO_SM4_ENABLE
    bool "CRYPTO_SM4_ENABLE"
    default 1

config  CRYPTO_SM2P256V1_ENABLE
    bool "CRYPTO_SM2P256V1_ENABLE"
    default 1

 config  CRYPTO_SM2_P192_ENABLE
    bool "CRYPTO_SM2_P192_ENABLE"
    default 1      
endif

endmenu
```

## examples/peripheral/crypto_ecjpake/Kconfig
```kconfig
menu "PROJECT CONFIG"

config  CRYPTO_AES_ENABLE
    bool "CRYPTO_AES_ENABLE"
    default true

config CRYPTO_SECP192R1_ENABLE
    bool "CRYPTO_SECP192R1_ENABLE"
    default true

config CRYPTO_SECP256R1_ENABLE
    bool "CRYPTO_SECP256R1_ENABLE"
    default true

config CRYPTO_SECT163R2_ENABLE
    bool "CRYPTO_SECT163R2_ENABLE"
    default true

config CRYPTO_C25519_ENABLE
    bool "CRYPTO_C25519_ENABLE"
    default true

config SUPPORT_MULTITASKING
    bool "SUPPORT_MULTITASKING"   
    default false
    
config CRYPTO_FREERTOS_ISR_ENABLE
    bool "CRYPTO_FREERTOS_ISR_ENABLE"   
    default false

config HOSAL_SOC_MAIN_ENTRY_TASK_SIZE
      int "HOSAL_SOC_MAIN_ENTRY_TASK_SIZE"
      default 1024

endmenu
```

## examples/peripheral/lpm/lpm_deep_sleep/Kconfig
```kconfig
menu "PROJECT CONFIG"

config SLEEP1_TEST_ENABLE
    bool "SLEEP1_TEST_ENABLE"
    default true

config SLEEP2_TEST_ENABLE
    bool "SLEEP2_TEST_ENABLE"
    default true    
    
endmenu
```

## examples/peripheral/lpm/sleep/Kconfig
```kconfig
menu "PROJECT CONFIG"

if RT581 ||RT582 || RT583 

config SLEEP1_TEST_ENABLE
    bool "SLEEP1_TEST_ENABLE"
    default 1

config SLEEP2_TEST_ENABLE
    bool "SLEEP2_TEST_ENABLE"
    default 1    

endif

endmenu
```

## examples/peripheral/qspi/qspi_access_flash/Kconfig
```kconfig
menu "PROJECT CONFIG"

config APPLICATION_VERSION
    string "Application version"
	def_string "1.0.0"
    help
        Application version

endmenu
```

## examples/peripheral/sadc/sadc/Kconfig
```kconfig
menu "PROJECT CONFIG"

config SADC_COMP_DEBUG
    bool "enable sadc Compensation debug"
	def_bool false
    help
        enable Compensation debug log

config SADC_TEST_MODE
    bool "enable sadc test mode"
	def_bool false
    help
        enable sadc test mode

config SADC_CALIBRATION_VALUE
    int "calibration value"
	def_int 0

endmenu
```

## examples/peripheral/uart1_uart2_loopback/Kconfig
```kconfig
menu "PROJECT CONFIG"

config  CONFIG_MP_SECTOR
    bool "CONFIG_MP_SECTOR"
    default 1
    
endmenu
```
